## src/platform/esp32/sdkconfig.defaults
```kconfig
# ESP-IDF 项目配置
# UniCore ESP32 固件

idf.py menuconfig

# 项目配置
CONFIG_ESPTOOLPY_FLASHSIZE_4MB=y
CONFIG_PARTITION_TABLE_CUSTOM=y
CONFIG_ESPTOOLPY_FLASHFREQ_80M=y

# WiFi配置
CONFIG_ESP_WIFI_ENABLE=y
CONFIG_ESP_WIFI_SSID="UniCore"
CONFIG_ESP_WIFI_PASSWORD="12345678"

# 系统配置
CONFIG_FREERTOS_HZ=1000
CONFIG_ESP_TASK_WDT=y
CONFIG_ESP_SYSTEM_EVENT_QUEUE_SIZE=32

# UniCore配置
CONFIG_UNICORE_WASM_SIZE=49152
CONFIG_UNICORE_STACK_SIZE=8192
CONFIG_UNICORE_HEAP_SIZE=65536
```
